## versions/zephyr-3.7.1/west.yml
```yaml
manifest:
  remotes:
    - name: upstream
      url-base: https://github.com/zephyrproject-rtos

  projects:
    - name: zephyr
      remote: upstream
      revision: v3.7.1
      import:
        name-allowlist:
        - cmsis
        - hal_stm32
```

## versions/zephyr-4.1/west.yml
```yaml
manifest:
  version: 0.11

  defaults:
    remote: github
    revision: v4.1.0

  remotes:
    - name: github
      url-base: https://github.com/zephyrproject-rtos

  projects:
    - name: zephyr
      path: zephyr
      revision: v4.1.0

  self:
    path: zephyr

import:
  name: https://github.com/zephyrproject-rtos/zephyr/blob/v4.1.0/west.yml
  name-allowlist:
    - cmsis_6
    - hal_stm32
```

## versions/zephyr-4.3/west.yml
```yaml
manifest:
  remotes:
    - name: upstream
      url-base: https://github.com/zephyrproject-rtos

  projects:
    - name: zephyr
      remote: upstream
      revision: v4.3.0
      import:
        name-allowlist:
        - cmsis_6
        - hal_stm32
```
